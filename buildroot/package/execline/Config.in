## buildroot/package/execline/Config.in
```kconfig
config BR2_PACKAGE_EXECLINE
	bool "execline"
	depends on BR2_TOOLCHAIN_USES_GLIBC || BR2_TOOLCHAIN_USES_MUSL
	select BR2_PACKAGE_SKALIBS
	help
	  execline is a (non-interactive) scripting language, like sh ; but its
	  syntax is quite different from a traditional shell syntax.
	  The execlineb program is meant to be used as an interpreter for a text
	  file; the other commands are essentially useful inside an execlineb
	  script.

	  http://skarnet.org/software/execline/

comment "execline needs an (e)glibc or musl toolchain"
	depends on !BR2_TOOLCHAIN_USES_GLIBC && !BR2_TOOLCHAIN_USES_MUSL
```

## buildroot/package/execline/Config.in.host
```kconfig
config BR2_PACKAGE_HOST_EXECLINE
	bool "host execline"
	help
	  Host version of execline, a (non-interactive) scripting language,
	  like sh.

	  http://skarnet.org/software/execline/
```

## buildroot/package/s6-br2-init-services/Config.in
```kconfig
config BR2_PACKAGE_S6_BR2_INIT_SERVICES
	bool "s6-br2-init-services"
	depends on BR2_PACKAGE_S6_BR2_INIT_SKELETON
	help
	  Collection of s6-rc services to run various programs with a s6-based
	  init system.

	  https://github.com/elebihan/s6-br2-init-services
```

## buildroot/package/s6-dns/Config.in
```kconfig
config BR2_PACKAGE_S6_DNS
	bool "s6-dns"
	select BR2_PACKAGE_SKALIBS
	help
	  s6-dns is a suite of DNS client programs and libraries for Unix
	  systems, as an alternative to the BIND, djbdns or other DNS clients.

	  http://skarnet.org/software/s6-dns/
```

## buildroot/package/s6-linux-init-services/Config.in
```kconfig
config BR2_PACKAGE_S6_LINUX_INIT_SERVICES
	bool "s6-linux-init-services"
	depends on BR2_PACKAGE_S6_LINUX_INIT_SKELETON
	help
	  Collection of s6-rc services to run various programs with a s6-based
	  init system.

	  The supported programs are:

	  - dropbear
```

## buildroot/package/s6-linux-init-skeleton/Config.in
```kconfig
config BR2_PACKAGE_S6_LINUX_INIT_SKELETON
	bool
	depends on BR2_INIT_S6_INIT
	select BR2_PACKAGE_S6_RC
	select BR2_PACKAGE_S6_LINUX_UTILS
	select BR2_PACKAGE_S6_PORTABLE_UTILS
	select BR2_PACKAGE_S6_NETWORKING
	select BR2_PACKAGE_HOST_S6_RC
	help
	  Init system based on s6 for Linux systems

	  http://skarnet.org/software/s6-rc/why.html
```

## buildroot/package/s6-linux-init/Config.in
```kconfig
config BR2_PACKAGE_S6_LINUX_INIT
	bool "s6-linux-init"
	depends on BR2_TOOLCHAIN_USES_GLIBC || BR2_TOOLCHAIN_USES_MUSL
	select BR2_PACKAGE_S6
	select BR2_PACKAGE_S6_LINUX_UTILS
	select BR2_PACKAGE_S6_PORTABLE_UTILS
	help
	  s6-linux-init is a set of minimalistic tools to create a s6-based
	  init system, including a /sbin/init binary, on a Linux kernel.

	  http://skarnet.org/software/s6-linux-init/

comment "s6-linux-init needs an (e)glibc or musl toolchain"
	depends on !BR2_TOOLCHAIN_USES_GLIBC && !BR2_TOOLCHAIN_USES_MUSL
```

## buildroot/package/s6-linux-utils/Config.in
```kconfig
config BR2_PACKAGE_S6_LINUX_UTILS
	bool "s6-linux-utils"
	depends on BR2_TOOLCHAIN_USES_GLIBC || BR2_TOOLCHAIN_USES_MUSL
	select BR2_PACKAGE_SKALIBS
	help
	  s6-linux-utils is a set of minimalistic Linux-specific system
	  utilities.

	  http://skarnet.org/software/s6-linux-utils/

comment "s6-linux-utils needs an (e)glibc or musl toolchain"
	depends on !BR2_TOOLCHAIN_USES_GLIBC && !BR2_TOOLCHAIN_USES_MUSL
```

## buildroot/package/s6-portable-utils/Config.in
```kconfig
config BR2_PACKAGE_S6_PORTABLE_UTILS
	bool "s6-portable-utils"
	depends on BR2_TOOLCHAIN_USES_GLIBC || BR2_TOOLCHAIN_USES_MUSL
	select BR2_PACKAGE_SKALIBS
	help
	  s6-portable-utils is a set of tiny general Unix utilities, often
	  performing well-known tasks such as cut and grep, but optimized for
	  simplicity and small size. They were designed for embedded systems
	  and other constrained environments, but they work everywhere.

	  http://skarnet.org/software/s6-portable-utils/

comment "s6-portable-utils needs an (e)glibc or musl toolchain"
	depends on !BR2_TOOLCHAIN_USES_GLIBC && !BR2_TOOLCHAIN_USES_MUSL
```

## buildroot/package/s6-rc/Config.in.host
```kconfig
config BR2_PACKAGE_HOST_S6_RC
	bool "host s6-rc tools"
	help
	  Host tools from s6-rc for managing the service database.

	  http://skarnet.org/software/s6-rc/
```

## buildroot/package/s6/Config.in
```kconfig
config BR2_PACKAGE_S6
	bool "s6"
	depends on BR2_TOOLCHAIN_USES_GLIBC || BR2_TOOLCHAIN_USES_MUSL
	select BR2_PACKAGE_EXECLINE
	help
	  s6 is a small suite of programs for UNIX, designed to allow process
	  supervision (a.k.a service supervision), in the line of daemontools
	  and runit, as well as various operations on processes and daemons.

	  http://skarnet.org/software/s6/

comment "s6 needs an (e)glibc or musl toolchain"
	depends on !BR2_TOOLCHAIN_USES_GLIBC && !BR2_TOOLCHAIN_USES_MUSL
```

## buildroot/package/skalibs/Config.in
```kconfig
config BR2_PACKAGE_SKALIBS
	bool "skalibs"
	depends on BR2_USE_MMU # fork()
	help
	  skalibs is a package centralizing the free software / open source C
	  development files used for building all software at skarnet.org:
	  it contains essentially general-purpose libraries.

	  http://skarnet.org/software/skalibs/
```

## custom/configs/demo_s6_odroidc2_defconfig
```kconfig
BR2_aarch64=y
BR2_KERNEL_HEADERS_VERSION=y
BR2_DEFAULT_KERNEL_VERSION="3.14.29"
BR2_PACKAGE_HOST_LINUX_HEADERS_CUSTOM_3_14=y
BR2_TARGET_GENERIC_HOSTNAME="odroidc2"
BR2_TARGET_GENERIC_ISSUE="Welcome to S6 demo"
BR2_INIT_S6_INIT=y
BR2_ROOTFS_DEVICE_TABLE="system/device_table.txt $(BR2_EXTERNAL)/board/common/device_table.txt"
BR2_SYSTEM_DHCP="eth0"
BR2_TARGET_LDCONFIG=y
BR2_ROOTFS_OVERLAY="$(BR2_EXTERNAL)/board/common/overlay $(BR2_EXTERNAL)/board/hardkernel/odroidc2/overlay"
BR2_ROOTFS_POST_BUILD_SCRIPT="$(BR2_EXTERNAL)/board/hardkernel/odroidc2/post-build.sh $(BR2_EXTERNAL)/board/common/post-build.sh"
BR2_ROOTFS_POST_IMAGE_SCRIPT="board/hardkernel/odroidc2/post-image.sh"
BR2_LINUX_KERNEL=y
BR2_LINUX_KERNEL_CUSTOM_GIT=y
BR2_LINUX_KERNEL_CUSTOM_REPO_URL="https://github.com/hardkernel/linux.git"
BR2_LINUX_KERNEL_CUSTOM_REPO_VERSION="1cb48cebb9d525e524de0ede46710bb29f54d4a6"
BR2_LINUX_KERNEL_DEFCONFIG="odroidc2"
BR2_LINUX_KERNEL_DTS_SUPPORT=y
BR2_LINUX_KERNEL_INTREE_DTS_NAME="meson64_odroidc2"
BR2_PACKAGE_ODROID_MALI=y
BR2_PACKAGE_S6_BR2_INIT_SERVICES=y
BR2_PACKAGE_DROPBEAR=y
BR2_PACKAGE_NTP=y
BR2_PACKAGE_S6_LINUX_INIT=y
BR2_TARGET_ROOTFS_EXT2=y
BR2_TARGET_ROOTFS_EXT2_4=y
BR2_TARGET_UBOOT=y
BR2_TARGET_UBOOT_BOARDNAME="odroidc2"
BR2_TARGET_UBOOT_CUSTOM_GIT=y
BR2_TARGET_UBOOT_CUSTOM_REPO_URL="https://github.com/hardkernel/u-boot.git"
BR2_TARGET_UBOOT_CUSTOM_REPO_VERSION="1ec799cec97574a9838bc25b286484e579a41652"
BR2_PACKAGE_HOST_DOSFSTOOLS=y
BR2_PACKAGE_HOST_GENIMAGE=y
BR2_PACKAGE_HOST_MTOOLS=y
```

## custom/configs/demo_s6_qemu_x86_defconfig
```kconfig
BR2_x86_pentiumpro=y
BR2_ENABLE_DEBUG=y
BR2_DEBUG_3=y
BR2_OPTIMIZE_0=y
BR2_PACKAGE_HOST_LINUX_HEADERS_CUSTOM_4_4=y
BR2_TOOLCHAIN_BUILDROOT_GLIBC=y
BR2_GLIBC_VERSION_2_22=y
BR2_GCC_VERSION_5_X=y
BR2_TOOLCHAIN_BUILDROOT_CXX=y
BR2_PACKAGE_HOST_GDB=y
BR2_TARGET_GENERIC_ISSUE="Welcome to S6 demo"
BR2_INIT_S6_INIT=y
BR2_TARGET_GENERIC_ROOT_PASSWD="root"
BR2_TARGET_GENERIC_GETTY_PORT="tty1"
BR2_SYSTEM_DHCP="eth0"
BR2_ROOTFS_OVERLAY="$(BR2_EXTERNAL)/board/common/overlay"
BR2_ROOTFS_POST_BUILD_SCRIPT="$(BR2_EXTERNAL)/board/common/post-build.sh"
BR2_LINUX_KERNEL=y
BR2_LINUX_KERNEL_USE_CUSTOM_CONFIG=y
BR2_LINUX_KERNEL_CUSTOM_CONFIG_FILE="$(BR2_EXTERNAL)/board/qemu/x86/linux-4.4.config"
BR2_PACKAGE_BUSYBOX_CONFIG="$(BR2_EXTERNAL)/board/common/busybox.config"
BR2_PACKAGE_GDB=y
BR2_PACKAGE_STRACE=y
BR2_PACKAGE_KBD=y
BR2_PACKAGE_DROPBEAR=y
BR2_PACKAGE_S6_LINUX_INIT=y
BR2_TARGET_ROOTFS_EXT2=y
# BR2_TARGET_ROOTFS_TAR is not set
```

## custom/configs/demo_s6_rpi_defconfig
```kconfig
BR2_arm=y
BR2_arm1176jzf_s=y
BR2_STATIC_LIBS=y
BR2_PACKAGE_HOST_LINUX_HEADERS_CUSTOM_4_1=y
BR2_TOOLCHAIN_BUILDROOT_MUSL=y
BR2_GCC_VERSION_5_X=y
BR2_TOOLCHAIN_BUILDROOT_CXX=y
BR2_TARGET_GENERIC_ISSUE="Welcome to S6 demo"
BR2_INIT_S6_INIT=y
BR2_TARGET_GENERIC_ROOT_PASSWD="root"
BR2_TARGET_GENERIC_GETTY_PORT="tty1"
BR2_SYSTEM_DHCP="eth0"
BR2_ROOTFS_OVERLAY="$(BR2_EXTERNAL)/board/rpi/overlay"
BR2_ROOTFS_POST_IMAGE_SCRIPT="board/raspberrypi/post-image.sh"
BR2_LINUX_KERNEL=y
BR2_LINUX_KERNEL_CUSTOM_GIT=y
BR2_LINUX_KERNEL_CUSTOM_REPO_URL="https://github.com/raspberrypi/linux.git"
BR2_LINUX_KERNEL_CUSTOM_REPO_VERSION="d33d0293e245badc4ca6ede3984d8bb8ea63cb1a"
BR2_LINUX_KERNEL_DEFCONFIG="bcmrpi"
BR2_LINUX_KERNEL_DTS_SUPPORT=y
BR2_LINUX_KERNEL_INTREE_DTS_NAME="bcm2708-rpi-b bcm2708-rpi-b-plus bcm2708-rpi-cm"
BR2_PACKAGE_BUSYBOX_CONFIG="$(BR2_EXTERNAL)/board/common/busybox.config"
BR2_PACKAGE_RPI_FIRMWARE=y
# BR2_PACKAGE_RPI_FIRMWARE_INSTALL_DTB_OVERLAYS is not set
BR2_PACKAGE_RNG_TOOLS=y
BR2_PACKAGE_S6_LINUX_INIT_SERVICES=y
BR2_PACKAGE_DROPBEAR=y
BR2_PACKAGE_NTP=y
BR2_PACKAGE_S6_LINUX_INIT=y
BR2_TARGET_ROOTFS_EXT2=y
BR2_TARGET_ROOTFS_EXT2_4=y
# BR2_TARGET_ROOTFS_TAR is not set
BR2_PACKAGE_HOST_DOSFSTOOLS=y
BR2_PACKAGE_HOST_GENIMAGE=y
BR2_PACKAGE_HOST_MTOOLS=y
```

## custom/configs/demo_s6_uclibc_both_qemu_x86_defconfig
```kconfig
BR2_x86_pentiumpro=y
BR2_ENABLE_DEBUG=y
BR2_DEBUG_3=y
BR2_OPTIMIZE_0=y
BR2_SHARED_STATIC_LIBS=y
BR2_PACKAGE_HOST_LINUX_HEADERS_CUSTOM_4_5=y
BR2_GCC_VERSION_5_X=y
BR2_TOOLCHAIN_BUILDROOT_CXX=y
BR2_PACKAGE_HOST_GDB=y
BR2_TARGET_GENERIC_ISSUE="Welcome to S6 demo"
BR2_INIT_S6_INIT=y
BR2_ROOTFS_DEVICE_TABLE="system/device_table.txt $(BR2_EXTERNAL)/board/common/device_table.txt"
BR2_TARGET_GENERIC_ROOT_PASSWD="root"
BR2_TARGET_GENERIC_GETTY_PORT="tty1"
BR2_SYSTEM_DHCP="eth0"
BR2_ROOTFS_OVERLAY="$(BR2_EXTERNAL)/board/common/overlay $(BR2_EXTERNAL)/board/qemu/x86/overlay"
BR2_ROOTFS_POST_BUILD_SCRIPT="$(BR2_EXTERNAL)/board/common/post-build.sh"
BR2_LINUX_KERNEL=y
BR2_LINUX_KERNEL_USE_CUSTOM_CONFIG=y
BR2_LINUX_KERNEL_CUSTOM_CONFIG_FILE="$(BR2_EXTERNAL)/board/qemu/x86/linux-4.5.config"
BR2_PACKAGE_BUSYBOX_CONFIG="$(BR2_EXTERNAL)/board/common/busybox.config"
BR2_PACKAGE_BUSYBOX_WATCHDOG=y
BR2_PACKAGE_STRACE=y
BR2_PACKAGE_KBD=y
BR2_PACKAGE_S6_LINUX_INIT_SERVICES=y
BR2_PACKAGE_DROPBEAR=y
BR2_PACKAGE_NTP=y
BR2_PACKAGE_S6_LINUX_INIT=y
BR2_TARGET_ROOTFS_EXT2=y
# BR2_TARGET_ROOTFS_TAR is not set
```
